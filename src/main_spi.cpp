/**
 * Working SPI example for the SparkFun ICM-20948 on an ESP32.
 *
 * What this example does:
 * - initializes the ICM-20948 over SPI
 * - verifies that the IMU is reachable
 * - reads accelerometer, gyroscope, and magnetometer data
 * - smooths the raw values with a moving average
 * - prints the values in a Teleplot-friendly format
 * - tries to recover from repeated SPI communication errors
 *
 * Pin mapping, row by row:
 * - GPIO18 -> SPI_SCK  : SPI clock generated by the ESP32
 * - GPIO19 -> SPI_MISO : data from the ICM-20948 to the ESP32
 * - GPIO23 -> SPI_MOSI : commands and data from the ESP32 to the ICM-20948
 * - GPIO5  -> SPI_CS   : chip select for the ICM-20948
 *
 * Additional wiring:
 * - IMU VCC  -> ESP32 3V3
 * - IMU GND  -> ESP32 GND
 *
 * Notes:
 * - this example assumes the breakout is wired for SPI mode
 * - the selected SPI bus is the ESP32 default VSPI pin set
 */
#include <Arduino.h>
#include "ICM_20948.h"
#include <SPI.h>
#include <math.h>

#define SPI_SCK 18
#define SPI_MISO 19
#define SPI_MOSI 23
#define SPI_CS 5
#define SPI_FREQ_HZ 4000000
#define SPI_FAIL_THRESHOLD 4
#define NO_SAMPLE_TIMEOUT_MS 800
#define SPI_HARD_RESTART_DELAY_MS 250
#define MA_WINDOW_SIZE 10
#define MA_EPSILON 0.05

uint8_t spiErrorCount = 0;
uint32_t lastGoodSampleMs = 0;

ICM_20948_SPI myICM;

struct MovingAverage {
  float buffer[MA_WINDOW_SIZE];
  float sum = 0.0f;
  uint8_t head = 0;
  uint8_t count = 0;

  float add(float value) {
    if (count == MA_WINDOW_SIZE) {
      sum -= buffer[head];
    } else {
      count++;
    }

    buffer[head] = value;
    sum += value;
    head = (head + 1) % MA_WINDOW_SIZE;

    return sum / count;
  }
};

MovingAverage accAvg[3], gyrAvg[3], magAvg[3];
float lastAcc[3] = {NAN, NAN, NAN};
float lastGyr[3] = {NAN, NAN, NAN};
float lastMag[3] = {NAN, NAN, NAN};

inline bool changed(float a, float b) {
  if (isnan(b)) return true;
  return fabs(a - b) > MA_EPSILON;
}

void initSPIBus() {
  SPI.begin(SPI_SCK, SPI_MISO, SPI_MOSI, SPI_CS);
  pinMode(SPI_CS, OUTPUT);
  digitalWrite(SPI_CS, HIGH);
}

bool initIMU() {
  Serial.print("Initializing SPI IMU on CS pin ");
  Serial.println(SPI_CS);

  myICM.begin(SPI_CS, SPI, SPI_FREQ_HZ);
  if (myICM.status == ICM_20948_Stat_Ok) {
    Serial.println("IMU init ok via SPI");
    spiErrorCount = 0;
    return true;
  }

  Serial.print("IMU init failed -> ");
  Serial.println(myICM.statusString());
  return false;
}

void setup() {
  Serial.begin(115200);
  delay(100);

  Serial.println("\n\nICM-20948 9DoF IMU Test");
  Serial.println("=======================\n");
  Serial.println("Using SPI interface");

  initSPIBus();

  if (!initIMU()) {
    Serial.println("ICM-20948 SPI initialization failed.");
    while (1) {
      delay(1000);
    }
  }

  Serial.println("IMU initialized successfully!");
  lastGoodSampleMs = millis();
  delay(500);
}

bool recoverIMU() {
  Serial.println("[IMU] recovering SPI interface...");
  SPI.end();
  delay(5);
  initSPIBus();
  return initIMU();
}

void hardRestart() {
  Serial.println("[IMU] persistent SPI failure, restarting ESP32...");
  Serial.flush();
  delay(SPI_HARD_RESTART_DELAY_MS);
  ESP.restart();
}

void loop() {
  if (myICM.dataReady()) {
    // Read accelerometer, gyroscope, magnetometer, and temperature registers.
    myICM.getAGMT();

    if (myICM.status != ICM_20948_Stat_Ok) {
      spiErrorCount++;
      Serial.print("[SPI] read error: ");
      Serial.println(myICM.statusString());
      Serial.print("[SPI] consecutive errors: ");
      Serial.println(spiErrorCount);

      if (spiErrorCount >= SPI_FAIL_THRESHOLD) {
        if (!recoverIMU()) {
          hardRestart();
        } else {
          Serial.println("[IMU] recovery succeeded.");
          spiErrorCount = 0;
          lastGoodSampleMs = millis();
        }
      }

      return;
    }

    spiErrorCount = 0;

    float accVals[3] = {float(myICM.accX()), float(myICM.accY()), float(myICM.accZ())};
    float gyrVals[3] = {float(myICM.gyrX()), float(myICM.gyrY()), float(myICM.gyrZ())};
    float magVals[3] = {float(myICM.magX()), float(myICM.magY()), float(myICM.magZ())};

    float avgAcc[3];
    float avgGyr[3];
    float avgMag[3];

    for (uint8_t i = 0; i < 3; i++) {
      avgAcc[i] = accAvg[i].add(accVals[i]);
      avgGyr[i] = gyrAvg[i].add(gyrVals[i]);
      avgMag[i] = magAvg[i].add(magVals[i]);
    }

    // Only print when the smoothed values changed enough to be useful.
    bool shouldPrint =
      changed(avgAcc[0], lastAcc[0]) || changed(avgAcc[1], lastAcc[1]) || changed(avgAcc[2], lastAcc[2]) ||
      changed(avgGyr[0], lastGyr[0]) || changed(avgGyr[1], lastGyr[1]) || changed(avgGyr[2], lastGyr[2]) ||
      changed(avgMag[0], lastMag[0]) || changed(avgMag[1], lastMag[1]) || changed(avgMag[2], lastMag[2]);

    if (shouldPrint) {
      Serial.print(">acc_x:");
      Serial.println(avgAcc[0], 3);
      Serial.print(">acc_y:");
      Serial.println(avgAcc[1], 3);
      Serial.print(">acc_z:");
      Serial.println(avgAcc[2], 3);

      Serial.print(">gyr_x:");
      Serial.println(avgGyr[0], 3);
      Serial.print(">gyr_y:");
      Serial.println(avgGyr[1], 3);
      Serial.print(">gyr_z:");
      Serial.println(avgGyr[2], 3);

      Serial.print(">mag_x:");
      Serial.println(avgMag[0], 3);
      Serial.print(">mag_y:");
      Serial.println(avgMag[1], 3);
      Serial.print(">mag_z:");
      Serial.println(avgMag[2], 3);

      memcpy(lastAcc, avgAcc, sizeof(lastAcc));
      memcpy(lastGyr, avgGyr, sizeof(lastGyr));
      memcpy(lastMag, avgMag, sizeof(lastMag));
    }

    lastGoodSampleMs = millis();
  }

  if ((millis() - lastGoodSampleMs) > NO_SAMPLE_TIMEOUT_MS) {
    Serial.println("[SPI] no sample for too long, forcing restart");
    hardRestart();
  }

  delay(100);
}